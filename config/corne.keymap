// Copyright 2021 Manna Harbour
// https://github.com/manna-harbour/miryoku
&led_strip {
    chain-length = <27>;
};
#include "../miryoku/custom_config.h"
#include "../miryoku/mapping/42/corne.h"
#include "../miryoku/miryoku.dtsi"
